/dts-v1/;

/ {

	__fixups__ {
		accdet = "/fragment@5:target:0";
		aeon_gpio = "/fragment@23:target:0";
		apuart0 = "/fragment@13:target:0";
		audgpio = "/fragment@26:target:0";
		auxadc = "/fragment@35:target:0";
		bat_gm30 = "/fragment@31:target:0";
		cam_id = "/fragment@25:target:0";
		chosen = "/fragment@0:target:0";
		chr_stat = "/fragment@50:target:0";
		consys = "/fragment@8:target:0";
		dbmdx = "/fragment@34:target:0";
		det_5v = "/fragment@46:target:0";
		det_vbus = "/fragment@48:target:0";
		gpio_usage_mapping = "/fragment@43:target:0";
		gyro = "/fragment@3:target:0";
		i2c0 = "/fragment@9:target:0", "/fragment@37:target:0";
		i2c1 = "/fragment@28:target:0", "/fragment@29:target:0", "/fragment@38:target:0";
		i2c2 = "/fragment@10:target:0", "/fragment@39:target:0";
		i2c3 = "/fragment@40:target:0";
		i2c4 = "/fragment@41:target:0";
		i2c5 = "/fragment@42:target:0";
		irq_nfc = "/fragment@20:target:0";
		irtx_pwm = "/fragment@11:target:0";
		kd_camera_hw1 = "/fragment@22:target:0", "/fragment@60:target:0";
		keypad = "/fragment@62:target:0";
		main_pmic = "/fragment@52:target:0";
		md1_sim1_hot_plug_eint = "/fragment@53:target:0";
		msdc1_ins = "/fragment@49:target:0";
		mt_pmic_vcama_ldo_reg = "/fragment@54:target:0", "/fragment@60/__overlay__:vcama-supply:0", "/fragment@60/__overlay__:vcama_sub-supply:0";
		mt_pmic_vcamd_ldo_reg = "/fragment@57:target:0", "/fragment@60/__overlay__:vcamd-supply:0", "/fragment@60/__overlay__:vcamd_sub-supply:0";
		mt_pmic_vcamio_ldo_reg = "/fragment@58:target:0", "/fragment@60/__overlay__:vcamio-supply:0", "/fragment@60/__overlay__:vcamio_sub-supply:0";
		mt_pmic_vldo28_ldo_reg = "/fragment@59:target:0", "/fragment@60/__overlay__:vcamaf-supply:0", "/fragment@61/__overlay__:vtouch-supply:0";
		mt_pmic_vsim1_ldo_reg = "/fragment@55:target:0";
		mt_pmic_vsim2_ldo_reg = "/fragment@56:target:0";
		nfc = "/fragment@19:target:0";
		odm = "/fragment@1:target:0";
		otg_iddig = "/fragment@44:target:0";
		pio = "/fragment@1/__overlay__/panel@0:lcd_pwr_en_pin:0", "/fragment@1/__overlay__/panel@0:lcd_rst_pin:0", "/fragment@1/__overlay__/panel@0:lcd_pwr_bias_enp_pin:0", "/fragment@2:target:0", "/fragment@4:target:0", "/fragment@6:target:0", "/fragment@7:target:0", "/fragment@12:target:0", "/fragment@14:target:0", "/fragment@16:target:0", "/fragment@18:target:0", "/fragment@19/__overlay__:gpio-rst-std:0", "/fragment@19/__overlay__:gpio-irq-std:0", "/fragment@21:target:0", "/fragment@24:target:0", "/fragment@25/__overlay__:gpio-cam-id0-std:0", "/fragment@25/__overlay__:gpio-cam-id1-std:0", "/fragment@27:target:0", "/fragment@30:target:0", "/fragment@34/__overlay__:reset-gpio:0", "/fragment@34/__overlay__:reset-va_ve-gpio:0", "/fragment@34/__overlay__:sv-gpio:0", "/fragment@34/__overlay__:wakeup-gpio:0", "/fragment@34/__overlay__:wakeup-va_ve-gpio:0", "/fragment@43/__overlay__:GPIO_SIM1_SCLK:0", "/fragment@43/__overlay__:GPIO_SIM1_SRST:0", "/fragment@43/__overlay__:GPIO_SIM1_SIO:0", "/fragment@43/__overlay__:GPIO_SIM2_SCLK:0", "/fragment@43/__overlay__:GPIO_SIM2_SRST:0", "/fragment@43/__overlay__:GPIO_SIM2_SIO:0", "/fragment@43/__overlay__:GPIO_SIM1_HOT_PLUG:0", "/fragment@44/__overlay__:interrupt-parent:0", "/fragment@45/__overlay__:interrupt-parent:0", "/fragment@45/__overlay__:deb-gpios:0", "/fragment@46/__overlay__:interrupt-parent:0", "/fragment@46/__overlay__:deb-gpios:0", "/fragment@47/__overlay__:interrupt-parent:0", "/fragment@48/__overlay__:interrupt-parent:0", "/fragment@48/__overlay__:deb-gpios:0", "/fragment@49/__overlay__:interrupt-parent:0", "/fragment@50/__overlay__:interrupt-parent:0", "/fragment@51/__overlay__:interrupt-parent:0", "/fragment@51/__overlay__:deb-gpios:0", "/fragment@52/__overlay__:interrupt-parent:0";
		pmic_clock_buffer_ctrl = "/fragment@36:target:0";
		sar_sensor = "/fragment@15:target:0", "/fragment@51:target:0";
		spi0 = "/fragment@32:target:0";
		spi1 = "/fragment@33:target:0";
		tcl_dock = "/fragment@45:target:0";
		touch = "/fragment@17:target:0", "/fragment@47:target:0", "/fragment@61:target:0";
	};

	__local_fixups__ {

		fragment@1 {

			__overlay__ {

				cust_alsps@0 {
					pinctrl-0 = <0x0>;
					pinctrl-1 = <0x0>;
				};
			};
		};

		fragment@11 {

			__overlay__ {
				pinctrl-0 = <0x0>;
				pinctrl-1 = <0x0>;
			};
		};

		fragment@13 {

			__overlay__ {
				pinctrl-0 = <0x0>;
				pinctrl-1 = <0x0>;
				pinctrl-2 = <0x0>;
				pinctrl-3 = <0x0>;
				pinctrl-4 = <0x0>;
			};
		};

		fragment@15 {

			__overlay__ {
				pinctrl-0 = <0x0>;
				pinctrl-1 = <0x0>;
			};
		};

		fragment@17 {

			__overlay__ {
				pinctrl-0 = <0x0>;
				pinctrl-1 = <0x0>;
				pinctrl-2 = <0x0>;
				pinctrl-3 = <0x0>;
				pinctrl-4 = <0x0>;
				pinctrl-5 = <0x0>;
			};
		};

		fragment@22 {

			__overlay__ {
				pinctrl-0 = <0x0>;
				pinctrl-1 = <0x0>;
				pinctrl-10 = <0x0>;
				pinctrl-11 = <0x0>;
				pinctrl-12 = <0x0>;
				pinctrl-13 = <0x0>;
				pinctrl-14 = <0x0>;
				pinctrl-2 = <0x0>;
				pinctrl-3 = <0x0>;
				pinctrl-4 = <0x0>;
				pinctrl-5 = <0x0>;
				pinctrl-6 = <0x0>;
				pinctrl-7 = <0x0>;
				pinctrl-8 = <0x0>;
				pinctrl-9 = <0x0>;
			};
		};

		fragment@23 {

			__overlay__ {
				pinctrl-0 = <0x0>;
				pinctrl-1 = <0x0>;
				pinctrl-10 = <0x0>;
				pinctrl-11 = <0x0>;
				pinctrl-12 = <0x0>;
				pinctrl-13 = <0x0>;
				pinctrl-14 = <0x0>;
				pinctrl-15 = <0x0>;
				pinctrl-16 = <0x0>;
				pinctrl-17 = <0x0>;
				pinctrl-18 = <0x0>;
				pinctrl-19 = <0x0>;
				pinctrl-2 = <0x0>;
				pinctrl-20 = <0x0>;
				pinctrl-21 = <0x0>;
				pinctrl-22 = <0x0>;
				pinctrl-23 = <0x0>;
				pinctrl-24 = <0x0>;
				pinctrl-25 = <0x0>;
				pinctrl-26 = <0x0>;
				pinctrl-27 = <0x0>;
				pinctrl-3 = <0x0>;
				pinctrl-4 = <0x0>;
				pinctrl-5 = <0x0>;
				pinctrl-6 = <0x0>;
				pinctrl-7 = <0x0>;
				pinctrl-8 = <0x0>;
				pinctrl-9 = <0x0>;
			};
		};

		fragment@26 {

			__overlay__ {
				pinctrl-0 = <0x0>;
				pinctrl-1 = <0x0>;
				pinctrl-2 = <0x0>;
				pinctrl-3 = <0x0>;
				pinctrl-4 = <0x0>;
				pinctrl-5 = <0x0>;
			};
		};

		fragment@28 {

			__overlay__ {

				hl7005@6a {
					pinctrl-0 = <0x0>;
					pinctrl-1 = <0x0>;
					pinctrl-2 = <0x0>;
				};
			};
		};

		fragment@29 {

			__overlay__ {

				hl7005@6a {
					pinctrl-0 = <0x0>;
					pinctrl-1 = <0x0>;
					pinctrl-2 = <0x0>;
				};
			};
		};

		fragment@3 {

			__overlay__ {
				pinctrl-0 = <0x0>;
				pinctrl-1 = <0x0>;
			};
		};

		fragment@34 {

			__overlay__ {
				cd-interfaces = <0x0 0x4>;
			};
		};

		fragment@5 {

			__overlay__ {
				pinctrl-0 = <0x0>;
				pinctrl-1 = <0x0>;
			};
		};

		fragment@8 {

			__overlay__ {
				pinctrl-0 = <0x0>;
				pinctrl-1 = <0x0>;
				pinctrl-2 = <0x0>;
				pinctrl-3 = <0x0>;
			};
		};
	};

	__symbols__ {
		accdet_pins_default = "/fragment@6/__overlay__/accdetdefault";
		accdet_pins_eint_as_int = "/fragment@6/__overlay__/accdeteint@0";
		alsps_intpin_cfg = "/fragment@4/__overlay__/alspspincfg";
		alsps_intpin_default = "/fragment@4/__overlay__/alspsdefaultcfg";
		alsps_mtk = "/fragment@38/__overlay__/alsps@51";
		aud_dat_miso_off = "/fragment@27/__overlay__/aud_dat_miso_off";
		aud_dat_miso_on = "/fragment@27/__overlay__/aud_dat_miso_on";
		aud_dat_mosi_off = "/fragment@27/__overlay__/aud_dat_mosi_off";
		aud_dat_mosi_on = "/fragment@27/__overlay__/aud_dat_mosi_on";
		aud_pins_extamp_high = "/fragment@27/__overlay__/audexamphigh";
		aud_pins_extamp_low = "/fragment@27/__overlay__/audexamplow";
		barometer_mtk = "/fragment@38/__overlay__/barometer@77";
		box5v_en2_high = "/fragment@24/__overlay__/box5v_en2_high";
		box5v_en2_input = "/fragment@24/__overlay__/box5v_en2_input";
		box5v_en2_low = "/fragment@24/__overlay__/box5v_en2_low";
		box5v_en_high = "/fragment@24/__overlay__/box5v_en_high";
		box5v_en_low = "/fragment@24/__overlay__/box5v_en_low";
		camera_main_af_mtk = "/fragment@39/__overlay__/camera_main_af@72";
		camera_main_eeprom_mtk = "/fragment@39/__overlay__/camera_main_eeprom@3d";
		camera_main_mtk = "/fragment@39/__overlay__/camera_main@3c";
		camera_pins_cam0_mclk_off = "/fragment@21/__overlay__/camera_pins_cam0_mclk_off";
		camera_pins_cam0_mclk_on = "/fragment@21/__overlay__/camera_pins_cam0_mclk_on";
		camera_pins_cam0_pnd0 = "/fragment@21/__overlay__/cam0@2";
		camera_pins_cam0_pnd1 = "/fragment@21/__overlay__/cam0@3";
		camera_pins_cam0_rst0 = "/fragment@21/__overlay__/cam0@0";
		camera_pins_cam0_rst1 = "/fragment@21/__overlay__/cam0@1";
		camera_pins_cam1_mclk_off = "/fragment@21/__overlay__/camera_pins_cam1_mclk_off";
		camera_pins_cam1_mclk_on = "/fragment@21/__overlay__/camera_pins_cam1_mclk_on";
		camera_pins_cam1_pnd0 = "/fragment@21/__overlay__/cam1@2";
		camera_pins_cam1_pnd1 = "/fragment@21/__overlay__/cam1@3";
		camera_pins_cam1_rst0 = "/fragment@21/__overlay__/cam1@0";
		camera_pins_cam1_rst1 = "/fragment@21/__overlay__/cam1@1";
		camera_pins_cam_ldo_sub_vcamd_0 = "/fragment@21/__overlay__/cam1@vcamd0";
		camera_pins_cam_ldo_sub_vcamd_1 = "/fragment@21/__overlay__/cam1@vcamd1";
		camera_pins_default = "/fragment@21/__overlay__/camdefault";
		camera_sub_eeprom_mtk = "/fragment@39/__overlay__/camera_sub_eeprom@37";
		camera_sub_mtk = "/fragment@39/__overlay__/camera_sub@36";
		chg_en_default = "/fragment@30/__overlay__/chg_en_default";
		chg_en_high = "/fragment@30/__overlay__/chg_en_high";
		chg_en_low = "/fragment@30/__overlay__/chg_en_low";
		consys_pins_default = "/fragment@7/__overlay__/consys_default";
		ctp_pins_default = "/fragment@18/__overlay__/eint0default";
		ctp_pins_eint_as_int = "/fragment@18/__overlay__/eint@0";
		ctp_pins_eint_output0 = "/fragment@18/__overlay__/eintoutput0";
		ctp_pins_eint_output1 = "/fragment@18/__overlay__/eintoutput1";
		ctp_pins_rst_output0 = "/fragment@18/__overlay__/rstoutput0";
		ctp_pins_rst_output1 = "/fragment@18/__overlay__/rstoutput1";
		dbmd2_spi = "/fragment@33/__overlay__/dbmd2_interface@0x0";
		dbmd4_spi = "/fragment@32/__overlay__/dbmd4_interface@0x0";
		det_5v_input = "/fragment@24/__overlay__/det_5v_input";
		dspg_26mclk_en0 = "/fragment@24/__overlay__/dspg_26mclk_en0";
		dspg_26mclk_en1 = "/fragment@24/__overlay__/dspg_26mclk_en1";
		dspg_d2_wakeup_en0 = "/fragment@24/__overlay__/dspg_d2_wakeup_en0";
		dspg_d2_wakeup_en1 = "/fragment@24/__overlay__/dspg_d2_wakeup_en1";
		dspg_d4_wakeup_en0 = "/fragment@24/__overlay__/dspg_d4_wakeup_en0";
		dspg_d4_wakeup_en1 = "/fragment@24/__overlay__/dspg_d4_wakeup_en1";
		gpslna_pins_init = "/fragment@7/__overlay__/gpslna@0";
		gpslna_pins_oh = "/fragment@7/__overlay__/gpslna@1";
		gpslna_pins_ol = "/fragment@7/__overlay__/gpslna@2";
		gsensor_mtk = "/fragment@38/__overlay__/gsensor@18";
		gyro_intpin_cfg = "/fragment@2/__overlay__/gyropincfg";
		gyro_intpin_default = "/fragment@2/__overlay__/gyrodefaultcfg";
		gyro_mtk = "/fragment@38/__overlay__/gyro@69";
		hearphone_spk_select_high = "/fragment@24/__overlay__/hearphone_spk_select_high";
		hearphone_spk_select_low = "/fragment@24/__overlay__/hearphone_spk_select_low";
		i2c_lcd_bias_mtk = "/fragment@37/__overlay__/i2c_lcd_bias@3e";
		irtx_gpio_led_default = "/fragment@12/__overlay__/irtx_gpio_led_def@gpio12";
		irtx_gpio_led_set = "/fragment@12/__overlay__/irtx_gpio_led_set@gpio12";
		lcd_bias_2_en0 = "/fragment@24/__overlay__/lcd_bias_2_en0";
		lcd_bias_2_en1 = "/fragment@24/__overlay__/lcd_bias_2_en1";
		lcd_bias_en0 = "/fragment@24/__overlay__/lcd_bias_en0";
		lcd_bias_en1 = "/fragment@24/__overlay__/lcd_bias_en1";
		lcd_ldo3_3_en0 = "/fragment@24/__overlay__/lcd_ldo3_3_en0";
		lcd_ldo3_3_en1 = "/fragment@24/__overlay__/lcd_ldo3_3_en1";
		lcd_rst_en0 = "/fragment@24/__overlay__/lcd_rst_en0";
		lcd_rst_en1 = "/fragment@24/__overlay__/lcd_rst_en1";
		led0 = "/fragment@1/__overlay__/led@0";
		led1 = "/fragment@1/__overlay__/led@1";
		led2 = "/fragment@1/__overlay__/led@2";
		led3 = "/fragment@1/__overlay__/led@3";
		led4 = "/fragment@1/__overlay__/led@4";
		led5 = "/fragment@1/__overlay__/led@5";
		led6 = "/fragment@1/__overlay__/led@6";
		main_mic_select_ap = "/fragment@24/__overlay__/main_mic_select_ap";
		main_mic_select_dsp = "/fragment@24/__overlay__/main_mic_select_dsp";
		msensor_mtk = "/fragment@38/__overlay__/msensor@0c";
		panel = "/fragment@1/__overlay__/panel@0";
		sar_intpin_active = "/fragment@16/__overlay__/sar_intpin_active";
		sar_intpin_default = "/fragment@16/__overlay__/sar_intpin_default";
		spkbox_eint_input = "/fragment@24/__overlay__/spkbox_eint_input";
		strobe_main_mtk = "/fragment@38/__overlay__/strobe_main@63";
		sw_charger_mtk = "/fragment@38/__overlay__/sw_charger@6a";
		uart0_gpio_def_cfg = "/fragment@14/__overlay__/uart0gpiodefault";
		uart0_rx_clr_cfg = "/fragment@14/__overlay__/uart0_rx_clear@gpio20";
		uart0_rx_set_cfg = "/fragment@14/__overlay__/uart0_rx_set@gpio20";
		uart0_tx_clr_cfg = "/fragment@14/__overlay__/uart0_tx_clear@gpio21";
		uart0_tx_set_cfg = "/fragment@14/__overlay__/uart0_tx_set@gpio21";
		vbus_det_input = "/fragment@24/__overlay__/vbus_det_input";
		vbus_en_high = "/fragment@24/__overlay__/vbus_en_high";
		vbus_en_low = "/fragment@24/__overlay__/vbus_en_low";
		vibrator0 = "/fragment@1/__overlay__/vibrator@0";
	};

	fragment@0 {
		target = <0xffffffff>;

		__overlay__ {
			atag,videolfb-fb_base_h = <0x0>;
			atag,videolfb-fb_base_l = "^`P";
			atag,videolfb-fps = <0x1770>;
			atag,videolfb-islcm_inited = <0x0>;
			atag,videolfb-islcmfound = <0x1>;
			atag,videolfb-lcmname = "jd9365_hd720_dsi";
			atag,videolfb-vramSize = <0x17bb000>;
		};
	};

	fragment@1 {
		target = <0xffffffff>;

		__overlay__ {

			cust_alsps@0 {
				als_level = <0x0 0x148 0x35d 0x561 0xc35 0x1e29 0x1e57 0x314d 0x5a16 0x6f0e 0x81fa 0xb80c 0xe15e 0xe15e 0xffff>;
				als_value = <0x0 0x85 0x130 0x1f6 0x3ec 0x7d5 0xbf2 0x138d 0x1f48 0x271a 0x2ee0 0x3e80 0x4e20 0x4e20 0x4e20 0x4e20>;
				compatible = "mediatek,cm36558";
				i2c_addr = <0x51 0x0 0x0 0x0>;
				i2c_num = <0x1>;
				is_batch_supported_als = <0x0>;
				is_batch_supported_ps = <0x0>;
				pinctrl-0 = <0x1>;
				pinctrl-1 = <0x2>;
				pinctrl-names = "pin_default", "pin_cfg";
				polling_mode_als = <0x1>;
				polling_mode_ps = <0x0>;
				power_id = <0xffff>;
				power_vol = <0x0>;
				ps_threshold_high = <0x1a>;
				ps_threshold_low = <0x15>;
			};

			cust_baro@0 {
				compatible = "mediatek,bmp280new";
				direction = <0x0>;
				firlen = <0x20>;
				i2c_num = <0x1>;
				is_batch_supported = <0x0>;
				power_id = <0xffff>;
				power_vol = <0x0>;
			};

			led@0 {
				compatible = "mediatek,red";
				data = <0x1>;
				led_mode = <0x0>;
				linux,phandle = <0x50>;
				phandle = <0x50>;
				pwm_config = <0x0 0x0 0x0 0x0 0x0>;
			};

			led@1 {
				compatible = "mediatek,green";
				data = <0x1>;
				led_mode = <0x0>;
				linux,phandle = <0x51>;
				phandle = <0x51>;
				pwm_config = <0x0 0x0 0x0 0x0 0x0>;
			};

			led@2 {
				compatible = "mediatek,blue";
				data = <0x1>;
				led_mode = <0x0>;
				linux,phandle = <0x52>;
				phandle = <0x52>;
				pwm_config = <0x0 0x0 0x0 0x0 0x0>;
			};

			led@3 {
				compatible = "mediatek,jogball-backlight";
				data = <0x1>;
				led_mode = <0x0>;
				linux,phandle = <0x53>;
				phandle = <0x53>;
				pwm_config = <0x0 0x0 0x0 0x0 0x0>;
			};

			led@4 {
				compatible = "mediatek,keyboard-backlight";
				data = <0x1>;
				led_mode = <0x0>;
				linux,phandle = <0x54>;
				phandle = <0x54>;
				pwm_config = <0x0 0x0 0x0 0x0 0x0>;
			};

			led@5 {
				compatible = "mediatek,button-backlight";
				data = <0x1>;
				led_mode = <0x0>;
				linux,phandle = <0x55>;
				phandle = <0x55>;
				pwm_config = <0x0 0x0 0x0 0x0 0x0>;
			};

			led@6 {
				compatible = "mediatek,lcd-backlight";
				data = <0x1>;
				led_mode = <0x5>;
				linux,phandle = <0x56>;
				phandle = <0x56>;
				pwm_config = <0x0 0x0 0x0 0x0 0x0>;
			};

			panel@0 {
				compatible = "jdi,jd9365_dsi_vdo";
				lcd_pwr_bias_enp_pin = <0xffffffff 0x7a 0x0>;
				lcd_pwr_en_pin = <0xffffffff 0x25 0x0>;
				lcd_rst_pin = <0xffffffff 0x53 0x0>;
				linux,phandle = <0x58>;
				phandle = <0x58>;
				status = "okay";
			};

			vibrator@0 {
				compatible = "mediatek,vibrator";
				linux,phandle = <0x57>;
				phandle = <0x57>;
				vib_limit = <0x9>;
				vib_timer = <0x19>;
				vib_vol = <0x9>;
			};
		};
	};

	fragment@10 {
		target = <0xffffffff>;

		__overlay__ {
			#address-cells = <0x1>;
			#size-cells = <0x0>;
			clock-frequency = <0x61a80>;

			mtk-usb@60 {
				compatible = "mediatek,mtk-usb";
				reg = <0x60>;
				status = "okay";
			};
		};
	};

	fragment@11 {
		target = <0xffffffff>;

		__overlay__ {
			pinctrl-0 = <0xb>;
			pinctrl-1 = <0xc>;
			pinctrl-names = "irtx_gpio_led_default", "irtx_gpio_led_set";
			status = "okay";
		};
	};

	fragment@12 {
		target = <0xffffffff>;

		__overlay__ {

			irtx_gpio_led_def@gpio12 {
				linux,phandle = <0xb>;
				phandle = <0xb>;

				pins_cmd_dat {
					bias-disable;
					input-schmitt-enable = <0x0>;
					output-low;
					pins = <0xc00>;
					slew-rate = <0x1>;
				};
			};

			irtx_gpio_led_set@gpio12 {
				linux,phandle = <0xc>;
				phandle = <0xc>;

				pins_cmd_dat {
					output-high;
					pins = <0xc05>;
					slew-rate = <0x1>;
				};
			};
		};
	};

	fragment@13 {
		target = <0xffffffff>;

		__overlay__ {
			pinctrl-0 = <0xd>;
			pinctrl-1 = <0xe>;
			pinctrl-2 = <0xf>;
			pinctrl-3 = <0x10>;
			pinctrl-4 = <0x11>;
			pinctrl-names = "uart0_gpio_default", "uart0_rx_set", "uart0_rx_clear", "uart0_tx_set", "uart0_tx_clear";
			status = "okay";
		};
	};

	fragment@14 {
		target = <0xffffffff>;

		__overlay__ {

			uart0_rx_clear@gpio20 {
				linux,phandle = <0xf>;
				phandle = <0xf>;

				pins_cmd_dat {
					output-high;
					pins = <0x1400>;
					slew-rate = <0x1>;
				};
			};

			uart0_rx_set@gpio20 {
				linux,phandle = <0xe>;
				phandle = <0xe>;

				pins_cmd_dat {
					pins = <0x1401>;
				};
			};

			uart0_tx_clear@gpio21 {
				linux,phandle = <0x11>;
				phandle = <0x11>;

				pins_cmd_dat {
					output-high;
					pins = <0x1500>;
					slew-rate = <0x1>;
				};
			};

			uart0_tx_set@gpio21 {
				linux,phandle = <0x10>;
				phandle = <0x10>;

				pins_cmd_dat {
					pins = <0x1501>;
				};
			};

			uart0gpiodefault {
				linux,phandle = <0xd>;
				phandle = <0xd>;
			};
		};
	};

	fragment@15 {
		target = <0xffffffff>;

		__overlay__ {
			pinctrl-0 = <0x12>;
			pinctrl-1 = <0x13>;
			pinctrl-names = "sar_intpin_default", "sar_intpin_active";
			status = "okay";
		};
	};

	fragment@16 {
		target = <0xffffffff>;

		__overlay__ {

			sar_intpin_active {
				linux,phandle = <0x13>;
				phandle = <0x13>;

				pins_cmd_dat {
					bias-disable;
					pins = <0x8700>;
					slew-rate = <0x0>;
				};
			};

			sar_intpin_default {
				linux,phandle = <0x12>;
				phandle = <0x12>;
			};
		};
	};

	fragment@17 {
		target = <0xffffffff>;

		__overlay__ {
			pinctrl-0 = <0x14>;
			pinctrl-1 = <0x15>;
			pinctrl-2 = <0x16>;
			pinctrl-3 = <0x17>;
			pinctrl-4 = <0x18>;
			pinctrl-5 = <0x19>;
			pinctrl-names = "default", "state_eint_as_int", "state_eint_output0", "state_eint_output1", "state_rst_output0", "state_rst_output1";
			status = "okay";
			tpd-filter-custom-prameters = <0x0 0x0 0x0 0x0 0x0 0x0 0x0 0x0 0x0 0x0 0x0 0x0>;
			tpd-filter-custom-speed = <0x0 0x0 0x0>;
			tpd-filter-enable = <0x1>;
			tpd-filter-pixel-density = <0x6a>;
			tpd-key-dim-local = <0x5a 0x373 0x64 0x28 0xe6 0x373 0x64 0x28 0x172 0x373 0x64 0x28 0x0 0x0 0x0 0x0>;
			tpd-key-local = <0x8b 0xac 0x9e 0x0>;
			tpd-key-num = <0x3>;
			tpd-max-touch-num = <0xa>;
			tpd-resolution = <0x320 0x500>;
			use-tpd-button = <0x0>;
		};
	};

	fragment@18 {
		target = <0xffffffff>;

		__overlay__ {

			eint0default {
				linux,phandle = <0x14>;
				phandle = <0x14>;
			};

			eint@0 {
				linux,phandle = <0x15>;
				phandle = <0x15>;

				pins_cmd_dat {
					bias-disable;
					pins = <0x600>;
					slew-rate = <0x0>;
				};
			};

			eintoutput0 {
				linux,phandle = <0x16>;
				phandle = <0x16>;

				pins_cmd_dat {
					output-low;
					pins = <0x600>;
					slew-rate = <0x1>;
				};
			};

			eintoutput1 {
				linux,phandle = <0x17>;
				phandle = <0x17>;

				pins_cmd_dat {
					output-high;
					pins = <0x600>;
					slew-rate = <0x1>;
				};
			};

			rstoutput0 {
				linux,phandle = <0x18>;
				phandle = <0x18>;

				pins_cmd_dat {
					output-low;
					pins = <0x2300>;
					slew-rate = <0x1>;
				};
			};

			rstoutput1 {
				linux,phandle = <0x19>;
				phandle = <0x19>;

				pins_cmd_dat {
					output-high;
					pins = <0x2300>;
					slew-rate = <0x1>;
				};
			};
		};
	};

	fragment@19 {
		target = <0xffffffff>;

		__overlay__ {
			compatible = "mediatek,nfc-gpio-v2";
			gpio-irq = <0xe>;
			gpio-irq-std = <0xffffffff 0xe 0x0>;
			gpio-rst = <0x7>;
			gpio-rst-std = <0xffffffff 0x7 0x0>;
		};
	};

	fragment@2 {
		target = <0xffffffff>;

		__overlay__ {

			gyrodefaultcfg {
				linux,phandle = <0x3>;
				phandle = <0x3>;
			};

			gyropincfg {
				linux,phandle = <0x4>;
				phandle = <0x4>;

				pins_cmd_dat {
					bias-pull-down = <0x0>;
					pins = <0x500>;
					slew-rate = <0x0>;
				};
			};
		};
	};

	fragment@20 {
		target = <0xffffffff>;

		__overlay__ {
			compatible = "mediatek,irq_nfc-eint";
		};
	};

	fragment@21 {
		target = <0xffffffff>;

		__overlay__ {

			cam0@0 {
				linux,phandle = <0x1b>;
				phandle = <0x1b>;

				pins_cmd_dat {
					output-low;
					pins = <0x1e00>;
					slew-rate = <0x1>;
				};
			};

			cam0@1 {
				linux,phandle = <0x1c>;
				phandle = <0x1c>;

				pins_cmd_dat {
					output-high;
					pins = <0x1e00>;
					slew-rate = <0x1>;
				};
			};

			cam0@2 {
				linux,phandle = <0x1d>;
				phandle = <0x1d>;

				pins_cmd_dat {
					output-low;
					pins = <0x1c00>;
					slew-rate = <0x1>;
				};
			};

			cam0@3 {
				linux,phandle = <0x1e>;
				phandle = <0x1e>;

				pins_cmd_dat {
					output-high;
					pins = <0x1c00>;
					slew-rate = <0x1>;
				};
			};

			cam1@0 {
				linux,phandle = <0x1f>;
				phandle = <0x1f>;

				pins_cmd_dat {
					output-low;
					pins = <0x1600>;
					slew-rate = <0x1>;
				};
			};

			cam1@1 {
				linux,phandle = <0x20>;
				phandle = <0x20>;

				pins_cmd_dat {
					output-high;
					pins = <0x1600>;
					slew-rate = <0x1>;
				};
			};

			cam1@2 {
				linux,phandle = <0x21>;
				phandle = <0x21>;

				pins_cmd_dat {
					output-low;
					pins = <0x1700>;
					slew-rate = <0x1>;
				};
			};

			cam1@3 {
				linux,phandle = <0x22>;
				phandle = <0x22>;

				pins_cmd_dat {
					output-high;
					pins = <0x1700>;
					slew-rate = <0x1>;
				};
			};

			cam1@vcamd0 {
				linux,phandle = <0x23>;
				phandle = <0x23>;

				pins_cmd_dat {
					output-low;
					pins = <0x900>;
					slew-rate = <0x1>;
				};
			};

			cam1@vcamd1 {
				linux,phandle = <0x24>;
				phandle = <0x24>;

				pins_cmd_dat {
					output-high;
					pins = <0x900>;
					slew-rate = <0x1>;
				};
			};

			camdefault {
				linux,phandle = <0x1a>;
				phandle = <0x1a>;
			};

			camera_pins_cam0_mclk_off {
				linux,phandle = <0x26>;
				phandle = <0x26>;

				pins_cmd_dat {
					pins = <0x7e00>;
				};
			};

			camera_pins_cam0_mclk_on {
				linux,phandle = <0x25>;
				phandle = <0x25>;

				pins_cmd_dat {
					pins = <0x7e01>;
				};
			};

			camera_pins_cam1_mclk_off {
				linux,phandle = <0x28>;
				phandle = <0x28>;

				pins_cmd_dat {
					pins = <0x7e00>;
				};
			};

			camera_pins_cam1_mclk_on {
				linux,phandle = <0x27>;
				phandle = <0x27>;

				pins_cmd_dat {
					pins = <0x7e01>;
				};
			};
		};
	};

	fragment@22 {
		target = <0xffffffff>;

		__overlay__ {
			pinctrl-0 = <0x1a>;
			pinctrl-1 = <0x1b>;
			pinctrl-10 = <0x24>;
			pinctrl-11 = <0x25>;
			pinctrl-12 = <0x26>;
			pinctrl-13 = <0x27>;
			pinctrl-14 = <0x28>;
			pinctrl-2 = <0x1c>;
			pinctrl-3 = <0x1d>;
			pinctrl-4 = <0x1e>;
			pinctrl-5 = <0x1f>;
			pinctrl-6 = <0x20>;
			pinctrl-7 = <0x21>;
			pinctrl-8 = <0x22>;
			pinctrl-9 = <0x23>;
			pinctrl-names = "default", "cam0_rst0", "cam0_rst1", "cam0_pnd0", "cam0_pnd1", "cam1_rst0", "cam1_rst1", "cam1_pnd0", "cam1_pnd1", "cam_ldo_sub_vcamd_0", "cam_ldo_sub_vcamd_1", "cam0_mclk_on", "cam0_mclk_off", "cam1_mclk_on", "cam1_mclk_off";
			status = "okay";
		};
	};

	fragment@23 {
		target = <0xffffffff>;

		__overlay__ {
			pinctrl-0 = <0x29>;
			pinctrl-1 = <0x2a>;
			pinctrl-10 = <0x33>;
			pinctrl-11 = <0x34>;
			pinctrl-12 = <0x35>;
			pinctrl-13 = <0x36>;
			pinctrl-14 = <0x37>;
			pinctrl-15 = <0x38>;
			pinctrl-16 = <0x39>;
			pinctrl-17 = <0x3a>;
			pinctrl-18 = <0x3b>;
			pinctrl-19 = <0x3c>;
			pinctrl-2 = <0x2b>;
			pinctrl-20 = <0x3d>;
			pinctrl-21 = <0x3e>;
			pinctrl-22 = <0x3f>;
			pinctrl-23 = <0x40>;
			pinctrl-24 = <0x41>;
			pinctrl-25 = <0x42>;
			pinctrl-26 = <0x43>;
			pinctrl-27 = <0x44>;
			pinctrl-3 = <0x2c>;
			pinctrl-4 = <0x2d>;
			pinctrl-5 = <0x2e>;
			pinctrl-6 = <0x2f>;
			pinctrl-7 = <0x30>;
			pinctrl-8 = <0x31>;
			pinctrl-9 = <0x32>;
			pinctrl-names = "lcd_bias_en1", "lcd_bias_en0", "lcd_ldo3_3_en1", "lcd_ldo3_3_en0", "lcd_rst_en1", "lcd_rst_en0", "hearphone_spk_select_high", "hearphone_spk_select_low", "vbus_en_high", "vbus_en_low", "box5v_en_high", "box5v_en_low", "box5v_en2_high", "box5v_en2_low", "box5v_en2_input", "vbus_det_input", "det_5v_input", "spkbox_eint_input", "main_mic_select_ap", "main_mic_select_dsp", "dspg_26mclk_en1", "dspg_26mclk_en0", "dspg_d2_wakeup_en1", "dspg_d2_wakeup_en0", "dspg_d4_wakeup_en1", "dspg_d4_wakeup_en0", "lcd_bias_2_en1", "lcd_bias_2_en0";
			status = "okay";
		};
	};

	fragment@24 {
		target = <0xffffffff>;

		__overlay__ {

			box5v_en2_high {
				linux,phandle = <0x35>;
				phandle = <0x35>;

				pins_cmd_dat {
					output-high;
					pins = <0x1b00>;
					slew-rate = <0x1>;
				};
			};

			box5v_en2_input {
				linux,phandle = <0x37>;
				phandle = <0x37>;

				pins_cmd_dat {
					bias-disable;
					pins = <0x1b00>;
					slew-rate = <0x0>;
				};
			};

			box5v_en2_low {
				linux,phandle = <0x36>;
				phandle = <0x36>;

				pins_cmd_dat {
					output-low;
					pins = <0x1b00>;
					slew-rate = <0x1>;
				};
			};

			box5v_en_high {
				linux,phandle = <0x33>;
				phandle = <0x33>;

				pins_cmd_dat {
					output-high;
					pins = <0x0>;
					slew-rate = <0x1>;
				};
			};

			box5v_en_low {
				linux,phandle = <0x34>;
				phandle = <0x34>;

				pins_cmd_dat {
					output-low;
					pins = <0x0>;
					slew-rate = <0x1>;
				};
			};

			det_5v_input {
				linux,phandle = <0x39>;
				phandle = <0x39>;

				pins_cmd_dat {
					bias-disable;
					pins = <0x500>;
					slew-rate = <0x0>;
				};
			};

			dspg_26mclk_en0 {
				linux,phandle = <0x3e>;
				phandle = <0x3e>;

				pins_cmd_dat {
					output-low;
					pins = <0x7a00>;
					slew-rate = <0x1>;
				};
			};

			dspg_26mclk_en1 {
				linux,phandle = <0x3d>;
				phandle = <0x3d>;

				pins_cmd_dat {
					output-high;
					pins = <0x7a00>;
					slew-rate = <0x1>;
				};
			};

			dspg_d2_wakeup_en0 {
				linux,phandle = <0x40>;
				phandle = <0x40>;

				pins_cmd_dat {
					output-low;
					pins = <0x700>;
					slew-rate = <0x1>;
				};
			};

			dspg_d2_wakeup_en1 {
				linux,phandle = <0x3f>;
				phandle = <0x3f>;

				pins_cmd_dat {
					output-high;
					pins = <0x700>;
					slew-rate = <0x1>;
				};
			};

			dspg_d4_wakeup_en0 {
				linux,phandle = <0x42>;
				phandle = <0x42>;

				pins_cmd_dat {
					output-low;
					pins = <0xa00>;
					slew-rate = <0x1>;
				};
			};

			dspg_d4_wakeup_en1 {
				linux,phandle = <0x41>;
				phandle = <0x41>;

				pins_cmd_dat {
					output-high;
					pins = <0xa00>;
					slew-rate = <0x1>;
				};
			};

			hearphone_spk_select_high {
				linux,phandle = <0x2f>;
				phandle = <0x2f>;

				pins_cmd_dat {
					output-high;
					pins = <0x7700>;
					slew-rate = <0x1>;
				};
			};

			hearphone_spk_select_low {
				linux,phandle = <0x30>;
				phandle = <0x30>;

				pins_cmd_dat {
					output-low;
					pins = <0x7700>;
					slew-rate = <0x1>;
				};
			};

			lcd_bias_2_en0 {
				linux,phandle = <0x44>;
				phandle = <0x44>;

				pins_cmd_dat {
					output-low;
					pins = <0x8800>;
					slew-rate = <0x1>;
				};
			};

			lcd_bias_2_en1 {
				linux,phandle = <0x43>;
				phandle = <0x43>;

				pins_cmd_dat {
					output-high;
					pins = <0x8800>;
					slew-rate = <0x1>;
				};
			};

			lcd_bias_en0 {
				linux,phandle = <0x2a>;
				phandle = <0x2a>;

				pins_cmd_dat {
					output-low;
					pins = <0x1d00>;
					slew-rate = <0x1>;
				};
			};

			lcd_bias_en1 {
				linux,phandle = <0x29>;
				phandle = <0x29>;

				pins_cmd_dat {
					output-high;
					pins = <0x1d00>;
					slew-rate = <0x1>;
				};
			};

			lcd_ldo3_3_en0 {
				linux,phandle = <0x2c>;
				phandle = <0x2c>;

				pins_cmd_dat {
					output-low;
					pins = <0x2500>;
					slew-rate = <0x1>;
				};
			};

			lcd_ldo3_3_en1 {
				linux,phandle = <0x2b>;
				phandle = <0x2b>;

				pins_cmd_dat {
					output-high;
					pins = <0x2500>;
					slew-rate = <0x1>;
				};
			};

			lcd_rst_en0 {
				linux,phandle = <0x2e>;
				phandle = <0x2e>;

				pins_cmd_dat {
					output-low;
					pins = <0x5300>;
					slew-rate = <0x1>;
				};
			};

			lcd_rst_en1 {
				linux,phandle = <0x2d>;
				phandle = <0x2d>;

				pins_cmd_dat {
					output-high;
					pins = <0x5300>;
					slew-rate = <0x1>;
				};
			};

			main_mic_select_ap {
				linux,phandle = <0x3b>;
				phandle = <0x3b>;

				pins_cmd_dat {
					output-low;
					pins = <0x7b00>;
					slew-rate = <0x1>;
				};
			};

			main_mic_select_dsp {
				linux,phandle = <0x3c>;
				phandle = <0x3c>;

				pins_cmd_dat {
					output-high;
					pins = <0x7b00>;
					slew-rate = <0x1>;
				};
			};

			spkbox_eint_input {
				linux,phandle = <0x3a>;
				phandle = <0x3a>;

				pins_cmd_dat {
					bias-pull-up = <0xb>;
					pins = <0x400>;
					slew-rate = <0x0>;
				};
			};

			vbus_det_input {
				linux,phandle = <0x38>;
				phandle = <0x38>;

				pins_cmd_dat {
					bias-disable;
					pins = <0xe00>;
					slew-rate = <0x0>;
				};
			};

			vbus_en_high {
				linux,phandle = <0x31>;
				phandle = <0x31>;

				pins_cmd_dat {
					output-high;
					pins = <0xd00>;
					slew-rate = <0x1>;
				};
			};

			vbus_en_low {
				linux,phandle = <0x32>;
				phandle = <0x32>;

				pins_cmd_dat {
					output-low;
					pins = <0xd00>;
					slew-rate = <0x1>;
				};
			};
		};
	};

	fragment@25 {
		target = <0xffffffff>;

		__overlay__ {
			compatible = "mediatek,cam_id";
			gpio-cam-id0 = <0x60>;
			gpio-cam-id0-std = <0xffffffff 0x60 0x0>;
			gpio-cam-id1 = <0x76>;
			gpio-cam-id1-std = <0xffffffff 0x76 0x0>;
		};
	};

	fragment@26 {
		target = <0xffffffff>;

		__overlay__ {
			pinctrl-0 = <0x45>;
			pinctrl-1 = <0x46>;
			pinctrl-2 = <0x47>;
			pinctrl-3 = <0x48>;
			pinctrl-4 = <0x49>;
			pinctrl-5 = <0x4a>;
			pinctrl-names = "aud_dat_mosi_off", "aud_dat_mosi_on", "aud_dat_miso_off", "aud_dat_miso_on", "extamp-pullhigh", "extamp-pulllow";
			status = "okay";
		};
	};

	fragment@27 {
		target = <0xffffffff>;

		__overlay__ {

			aud_dat_miso_off {
				linux,phandle = <0x47>;
				phandle = <0x47>;

				pins_cmd1_dat {
					bias-disable;
					input-enable;
					pins = <0x4300>;
					slew-rate = <0x0>;
				};

				pins_cmd2_dat {
					bias-disable;
					input-enable;
					pins = <0x4400>;
					slew-rate = <0x0>;
				};
			};

			aud_dat_miso_on {
				linux,phandle = <0x48>;
				phandle = <0x48>;

				pins_cmd1_dat {
					pins = <0x4301>;
				};

				pins_cmd2_dat {
					pins = <0x4401>;
				};
			};

			aud_dat_mosi_off {
				linux,phandle = <0x45>;
				phandle = <0x45>;

				pins_cmd1_dat {
					bias-disable;
					input-enable;
					pins = <0x3f00>;
					slew-rate = <0x0>;
				};

				pins_cmd2_dat {
					bias-disable;
					input-enable;
					pins = <0x4000>;
					slew-rate = <0x0>;
				};
			};

			aud_dat_mosi_on {
				linux,phandle = <0x46>;
				phandle = <0x46>;

				pins_cmd1_dat {
					pins = <0x3f01>;
				};

				pins_cmd2_dat {
					pins = <0x4001>;
				};
			};

			audexamphigh {
				linux,phandle = <0x49>;
				phandle = <0x49>;

				pins_cmd1_dat {
					output-high;
					pins = <0xb00>;
					slew-rate = <0x1>;
				};

				pins_cmd2_dat {
					output-high;
					pins = <0xc00>;
					slew-rate = <0x1>;
				};
			};

			audexamplow {
				linux,phandle = <0x4a>;
				phandle = <0x4a>;

				pins_cmd1_dat {
					output-low;
					pins = <0xb00>;
					slew-rate = <0x1>;
				};

				pins_cmd2_dat {
					output-low;
					pins = <0xc00>;
					slew-rate = <0x1>;
				};
			};
		};
	};

	fragment@28 {
		target = <0xffffffff>;

		__overlay__ {

			es7210@40 {
				compatible = "mediatek,es7210";
				reg = <0x40>;
				status = "okay";
			};

			gsensor@18 {
				direction = <0x7>;
				firlen = <0x0>;
				i2c_addr = <0x18 0x0 0x0 0x0>;
				i2c_num = <0x1>;
				is_batch_supported = <0x0>;
				power_id = <0xffff>;
				power_vol = <0x0>;
			};

			gyro@69 {
				direction = <0x4>;
				firlen = <0x0>;
				i2c_addr = <0x69 0x0 0x0 0x0>;
				i2c_num = <0x1>;
				is_batch_supported = <0x0>;
				power_id = <0xffff>;
				power_vol = <0x0>;
			};

			hl7005@6a {
				aicr = <0x7a120>;
				charger_name = "primary_chg";
				compatible = "halo,hl7005";
				cv = <0x426030>;
				ichg = <0x17a6b0>;
				ieoc = <0x30d40>;
				pinctrl-0 = <0x4b>;
				pinctrl-1 = <0x4c>;
				pinctrl-2 = <0x4d>;
				pinctrl-names = "default", "psc_chg_en_low", "psc_chg_en_high";
				reg = <0x6a>;
				status = "okay";
			};

			msensor@0c {
				direction = <0x4>;
				i2c_addr = <0xc 0x0 0x0 0x0>;
				i2c_num = <0x1>;
				is_batch_supported = <0x0>;
				power_id = <0xffff>;
				power_vol = <0x0>;
			};
		};
	};

	fragment@29 {
		target = <0xffffffff>;

		__overlay__ {

			hl7005@6a {
				aicr = <0x7a120>;
				charger_name = "primary_chg";
				compatible = "halo,hl7005";
				cv = <0x426030>;
				ichg = <0x17a6b0>;
				ieoc = <0x30d40>;
				pinctrl-0 = <0x4b>;
				pinctrl-1 = <0x4c>;
				pinctrl-2 = <0x4d>;
				pinctrl-names = "default", "psc_chg_en_low", "psc_chg_en_high";
				reg = <0x6a>;
				status = "okay";
			};
		};
	};

	fragment@3 {
		target = <0xffffffff>;

		__overlay__ {
			pinctrl-0 = <0x3>;
			pinctrl-1 = <0x4>;
			pinctrl-names = "pin_default", "pin_cfg";
			status = "okay";
		};
	};

	fragment@30 {
		target = <0xffffffff>;

		__overlay__ {

			chg_en_default {
				linux,phandle = <0x4b>;
				phandle = <0x4b>;
			};

			chg_en_high {
				linux,phandle = <0x4d>;
				phandle = <0x4d>;

				pins_cmd_dat {
					bias-disable;
					output-high;
					pinmux = <0x5e00>;
					slew-rate = <0x1>;
				};
			};

			chg_en_low {
				linux,phandle = <0x4c>;
				phandle = <0x4c>;

				pins_cmd_dat {
					bias-disable;
					output-low;
					pinmux = <0x5e00>;
					slew-rate = <0x1>;
				};
			};
		};
	};

	fragment@31 {
		target = <0xffffffff>;

		__overlay__ {
			CAR_TUNE_VALUE = <0x4f>;
			DIFFERENCE_FULLOCV_ITH = <0x96>;
			EMBEDDED_SEL = <0x1>;
			FG_METER_RESISTANCE = <0x32>;
			KEEP_100_PERCENT = <0x3>;
			PMIC_SHUTDOWN_CURRENT = <0x14>;
			Q_MAX_SYS_VOLTAGE_BAT0 = <0xd48>;
			Q_MAX_SYS_VOLTAGE_BAT1 = <0xd48>;
			Q_MAX_SYS_VOLTAGE_BAT2 = <0xd48>;
			Q_MAX_SYS_VOLTAGE_BAT3 = <0xd48>;
			R_FG_VALUE = <0xa>;
			SHUTDOWN_1_TIME = <0x3c>;
			TEMPERATURE_T0 = <0x32>;
			TEMPERATURE_T1 = <0x19>;
			TEMPERATURE_T2 = <0x0>;
			TEMPERATURE_T3 = <0xfffffff6>;
			battery0_profile_t0 = <0x0 0xab5b 0x28a 0x1ae 0xaacb 0x5c6 0x35c 0xaa51 0x657 0x50a 0xa9dc 0x65b 0x6b9 0xa967 0x663 0x867 0xa8f2 0x66c 0xa15 0xa87c 0x668 0xbc3 0xa807 0x65c 0xd71 0xa791 0x65c 0xf1f 0xa71c 0x672 0x10ce 0xa69f 0x670 0x127c 0xa625 0x66b 0x142a 0xa5b0 0x66b 0x15d8 0xa53a 0x670 0x1786 0xa4c5 0x68a 0x1934 0xa44a 0x67b 0x1ae2 0xa3d4 0x679 0x1c91 0xa35f 0x67b 0x1e3f 0xa2e9 0x674 0x1fed 0xa274 0x671 0x219b 0xa200 0x67c 0x2349 0xa190 0x67d 0x24f7 0xa120 0x688 0x26a5 0xa0b0 0x68a 0x2854 0xa044 0x695 0x2a02 0x9fd6 0x69a 0x2bb0 0x9f68 0x69a 0x2d5e 0x9eff 0x69a 0x2f0c 0x9e9a 0x69a 0x30ba 0x9e34 0x69a 0x3269 0x9dcf 0x6b2 0x3417 0x9d6a 0x6ae 0x35c5 0x9d08 0x6a9 0x3773 0x9caa 0x6b0 0x3921 0x9c4f 0x6be 0x3acf 0x9bf5 0x6cb 0x3c7d 0x9ba0 0x6e7 0x3e2c 0x9b4b 0x6f4 0x3fda 0x9af6 0x703 0x4188 0x9aa0 0x70f 0x4336 0x9a4d 0x728 0x44e4 0x99f8 0x74d 0x4692 0x9991 0x75c 0x4841 0x9900 0x724 0x49ef 0x9856 0x6a1 0x4b9d 0x97e5 0x67f 0x4d4b 0x9791 0x679 0x4ef9 0x9747 0x674 0x50a7 0x9702 0x671 0x5255 0x96c5 0x677 0x5404 0x9680 0x66b 0x55b2 0x964b 0x67a 0x5760 0x9611 0x671 0x590e 0x95e1 0x67f 0x5abc 0x95b1 0x683 0x5c6a 0x957f 0x679 0x5e18 0x9553 0x67a 0x5fc7 0x9524 0x67d 0x6175 0x94ff 0x689 0x6323 0x94d5 0x680 0x64d1 0x94ae 0x685 0x667f 0x9488 0x692 0x682d 0x9465 0x69a 0x69dc 0x9444 0x69a 0x6b8a 0x941f 0x69b 0x6d38 0x9404 0x6a8 0x6ee6 0x93e5 0x6a9 0x7094 0x93c9 0x6b3 0x7242 0x93ae 0x6c1 0x73f0 0x938d 0x6c3 0x759f 0x9358 0x6aa 0x774d 0x9308 0x678 0x78fb 0x92b8 0x66b 0x7aa9 0x9287 0x66d 0x7c57 0x925f 0x675 0x7e05 0x9236 0x681 0x7fb4 0x9209 0x684 0x8162 0x91db 0x67b 0x8310 0x91b1 0x678 0x84be 0x918c 0x66d 0x866c 0x916b 0x677 0x881a 0x9142 0x685 0x89c8 0x910a 0x681 0x8b77 0x90ca 0x679 0x8d25 0x908e 0x67e 0x8ed3 0x9055 0x68b 0x9081 0x900a 0x689 0x922f 0x8fbf 0x67c 0x93dd 0x8faa 0x686 0x958b 0x8f9f 0x68b 0x973a 0x8f92 0x691 0x98e8 0x8f82 0x6a3 0x9a96 0x8f6c 0x6bf 0x9c44 0x8f3b 0x6e7 0x9df2 0x8e3a 0x6b1 0x9fa0 0x8c81 0x6bf 0xa14f 0x8a26 0x6e3 0xa2fd 0x86de 0x72f 0xa4ab 0x814c 0xa18 0xa659 0x7a75 0xffd>;
			battery0_profile_t0_num = <0x64>;
			battery0_profile_t1 = <0x0 0xab74 0x47e 0x1ae 0xaafa 0x510 0x35c 0xaa88 0x51b 0x50a 0xaa1f 0x51f 0x6b9 0xa9b5 0x52c 0x867 0xa943 0x530 0xa15 0xa8ce 0x523 0xbc3 0xa859 0x514 0xd71 0xa7e4 0x530 0xf1f 0xa76a 0x52a 0x10ce 0xa6f0 0x526 0x127c 0xa675 0x517 0x142a 0xa5fd 0x50a 0x15d8 0xa588 0x519 0x1786 0xa512 0x525 0x1934 0xa493 0x4fe 0x1ae2 0xa420 0x51a 0x1c91 0xa3ad 0x51d 0x1e3f 0xa335 0x508 0x1fed 0xa2be 0x500 0x219b 0xa24e 0x514 0x2349 0xa1d9 0x508 0x24f7 0xa16f 0x522 0x26a5 0xa100 0x53e 0x2854 0xa08c 0x53b 0x2a02 0xa01a 0x534 0x2bb0 0x9fac 0x530 0x2d5e 0x9f43 0x528 0x2f0c 0x9ede 0x537 0x30ba 0x9e94 0x56d 0x3269 0x9e40 0x57e 0x3417 0x9dbd 0x55b 0x35c5 0x9d28 0x545 0x3773 0x9ca2 0x550 0x3921 0x9c3a 0x56a 0x3acf 0x9bf1 0x584 0x3c7d 0x9bbc 0x5ad 0x3e2c 0x9b78 0x5c9 0x3fda 0x9b27 0x5e4 0x4188 0x9acc 0x5ef 0x4336 0x9a6c 0x5fe 0x44e4 0x9a04 0x60a 0x4692 0x997e 0x5bb 0x4841 0x98f4 0x56b 0x49ef 0x9873 0x510 0x4b9d 0x9807 0x4da 0x4d4b 0x97ae 0x4c2 0x4ef9 0x9762 0x4b9 0x50a7 0x971e 0x4b8 0x5255 0x96df 0x4b8 0x5404 0x969f 0x49e 0x55b2 0x9669 0x4a8 0x5760 0x9634 0x4ab 0x590e 0x95ff 0x4a3 0x5abc 0x95ce 0x4a7 0x5c6a 0x95a2 0x4b9 0x5e18 0x9571 0x4b7 0x5fc7 0x9541 0x4b7 0x6175 0x9517 0x4ae 0x6323 0x94f0 0x4b3 0x64d1 0x94cb 0x4b9 0x667f 0x94a6 0x4ba 0x682d 0x9482 0x4c1 0x69dc 0x9462 0x4d9 0x6b8a 0x9448 0x4e6 0x6d38 0x9428 0x4e7 0x6ee6 0x940c 0x4f1 0x7094 0x93eb 0x4e6 0x7242 0x93cb 0x4df 0x73f0 0x93ad 0x4e5 0x759f 0x9387 0x4d5 0x774d 0x935d 0x4bb 0x78fb 0x9328 0x4a1 0x7aa9 0x92ff 0x49a 0x7c57 0x92da 0x49a 0x7e05 0x92b5 0x49a 0x7fb4 0x928d 0x498 0x8162 0x925f 0x48c 0x8310 0x923e 0x499 0x84be 0x921e 0x49a 0x866c 0x91ff 0x4b0 0x881a 0x91d4 0x4c2 0x89c8 0x919d 0x4cf 0x8b77 0x915f 0x4d8 0x8d25 0x9125 0x4d8 0x8ed3 0x90e9 0x4d8 0x9081 0x90a0 0x4e7 0x922f 0x9051 0x4dd 0x93dd 0x9027 0x4d0 0x958b 0x901a 0x4dd 0x973a 0x9011 0x4f8 0x98e8 0x9001 0x4fc 0x9a96 0x8ff0 0x525 0x9c44 0x8fc1 0x54e 0x9df2 0x8f0e 0x54a 0x9fa0 0x8d96 0x54d 0xa14f 0x8b72 0x57b 0xa2fd 0x888c 0x5ee 0xa4ab 0x8419 0x7a1 0xa659 0x7c2d 0xe4a>;
			battery0_profile_t1_num = <0x64>;
			battery0_profile_t2 = <0x0 0xab93 0x13ba 0x1ae 0xaaf8 0x28fb 0x35c 0xaa6c 0x2cbe 0x50a 0xa9e1 0x2cae 0x6b9 0xa95a 0x2ceb 0x867 0xa8d3 0x2d5b 0xa15 0xa84a 0x2d57 0xbc3 0xa7cb 0x2d99 0xd71 0xa750 0x2de9 0xf1f 0xa6d6 0x2e5b 0x10ce 0xa65f 0x2eed 0x127c 0xa5e4 0x2f86 0x142a 0xa568 0x300d 0x15d8 0xa4f4 0x305d 0x1786 0xa484 0x3017 0x1934 0xa40f 0x30af 0x1ae2 0xa39e 0x3141 0x1c91 0xa32f 0x3159 0x1e3f 0xa2bf 0x3123 0x1fed 0xa24f 0x30d1 0x219b 0xa1e0 0x306f 0x2349 0xa16f 0x2fee 0x24f7 0xa105 0x2f5c 0x26a5 0xa096 0x2ee2 0x2854 0xa02d 0x2eb5 0x2a02 0x9fd4 0x2eae 0x2bb0 0x9f84 0x2ebd 0x2d5e 0x9f31 0x2ed8 0x2f0c 0x9ecf 0x2eb9 0x30ba 0x9e3f 0x2e24 0x3269 0x9d8a 0x2d58 0x3417 0x9cd7 0x2c71 0x35c5 0x9c34 0x2ba6 0x3773 0x9ba5 0x2b1d 0x3921 0x9b2e 0x2acd 0x3acf 0x9ac5 0x2a7b 0x3c7d 0x9a6b 0x2a2e 0x3e2c 0x9a1e 0x2a02 0x3fda 0x99d0 0x29d9 0x4188 0x997d 0x299a 0x4336 0x9928 0x294b 0x44e4 0x98d2 0x2901 0x4692 0x9877 0x28cb 0x4841 0x981c 0x2888 0x49ef 0x97cc 0x285f 0x4b9d 0x9780 0x2837 0x4d4b 0x9738 0x280e 0x4ef9 0x96f5 0x27f6 0x50a7 0x96b5 0x27f3 0x5255 0x9677 0x27e7 0x5404 0x9641 0x27e7 0x55b2 0x9607 0x27db 0x5760 0x95d4 0x27ce 0x590e 0x95a2 0x27c9 0x5abc 0x9571 0x27ce 0x5c6a 0x9545 0x27d5 0x5e18 0x9516 0x27c8 0x5fc7 0x94f1 0x27bb 0x6175 0x94c6 0x27b8 0x6323 0x94a4 0x27c3 0x64d1 0x9481 0x27d1 0x667f 0x945e 0x27d8 0x682d 0x943f 0x27df 0x69dc 0x9424 0x27f7 0x6b8a 0x940a 0x2804 0x6d38 0x93f5 0x281f 0x6ee6 0x93e3 0x283a 0x7094 0x93d3 0x285c 0x7242 0x93c3 0x2873 0x73f0 0x93b3 0x287e 0x759f 0x93a3 0x28a8 0x774d 0x9394 0x28ed 0x78fb 0x937f 0x293c 0x7aa9 0x9369 0x2995 0x7c57 0x9350 0x29f3 0x7e05 0x9336 0x2a56 0x7fb4 0x9318 0x2ac0 0x8162 0x92f2 0x2b2b 0x8310 0x92c2 0x2b97 0x84be 0x9297 0x2c25 0x866c 0x9263 0x2ccd 0x881a 0x922b 0x2d7b 0x89c8 0x91f1 0x2e48 0x8b77 0x91b3 0x2f34 0x8d25 0x916d 0x301d 0x8ed3 0x9128 0x3131 0x9081 0x90de 0x3266 0x922f 0x90a5 0x33c3 0x93dd 0x907a 0x355d 0x958b 0x9057 0x3748 0x973a 0x9035 0x3994 0x98e8 0x900c 0x3c55 0x9a96 0x8fcc 0x3fa9 0x9c44 0x8f42 0x438e 0x9df2 0x8e30 0x4754 0x9fa0 0x8c7f 0x4b1b 0xa14f 0x8a0c 0x4f14 0xa2fd 0x8665 0x53f8 0xa4ab 0x8228 0x594f 0xa659 0x8228 0x594f>;
			battery0_profile_t2_num = <0x64>;
			battery0_profile_t3 = <0x0 0xaafe 0x2c56 0x1ae 0xaa34 0x444a 0x35c 0xa96d 0x4821 0x50a 0xa8ab 0x4756 0x6b9 0xa7f9 0x4654 0x867 0xa756 0x4572 0xa15 0xa6b8 0x4490 0xbc3 0xa622 0x43ad 0xd71 0xa593 0x42d8 0xf1f 0xa50c 0x41df 0x10ce 0xa48a 0x40fe 0x127c 0xa40d 0x403e 0x142a 0xa394 0x3f9f 0x15d8 0xa31e 0x3f14 0x1786 0xa2a3 0x3e72 0x1934 0xa229 0x3dc6 0x1ae2 0xa1b8 0x3d3e 0x1c91 0xa147 0x3cb8 0x1e3f 0xa0e0 0x3c50 0x1fed 0xa080 0x3c06 0x219b 0xa021 0x3bcd 0x2349 0x9fc5 0x3bae 0x24f7 0x9f56 0x3b51 0x26a5 0x9ecd 0x3ace 0x2854 0x9e32 0x3a16 0x2a02 0x9d85 0x393d 0x2bb0 0x9cdb 0x387d 0x2d5e 0x9c47 0x37f3 0x2f0c 0x9bc2 0x377d 0x30ba 0x9b47 0x371f 0x3269 0x9ae1 0x36da 0x3417 0x9a84 0x36a3 0x35c5 0x9a33 0x3686 0x3773 0x99e8 0x3672 0x3921 0x999d 0x3660 0x3acf 0x9952 0x365c 0x3c7d 0x9902 0x3640 0x3e2c 0x98b2 0x361a 0x3fda 0x985e 0x35fc 0x4188 0x980f 0x35ea 0x4336 0x97c5 0x35d0 0x44e4 0x977c 0x35b2 0x4692 0x9736 0x35a7 0x4841 0x96f1 0x35a5 0x49ef 0x96b1 0x35a7 0x4b9d 0x9675 0x359c 0x4d4b 0x963b 0x358f 0x4ef9 0x9603 0x3596 0x50a7 0x95d0 0x35b4 0x5255 0x959e 0x35db 0x5404 0x9569 0x3603 0x55b2 0x9539 0x35f6 0x5760 0x950d 0x3621 0x590e 0x94e6 0x3644 0x5abc 0x94c4 0x367b 0x5c6a 0x94a6 0x36e3 0x5e18 0x948c 0x3763 0x5fc7 0x9471 0x379b 0x6175 0x945c 0x3806 0x6323 0x944b 0x3870 0x64d1 0x9437 0x38ef 0x667f 0x9425 0x398b 0x682d 0x9415 0x3a2c 0x69dc 0x9403 0x3acd 0x6b8a 0x93ef 0x3bac 0x6d38 0x93df 0x3cb7 0x6ee6 0x93ce 0x3da0 0x7094 0x93bb 0x3e9b 0x7242 0x93a5 0x3faa 0x73f0 0x9390 0x40a6 0x759f 0x9379 0x4187 0x774d 0x935e 0x4287 0x78fb 0x9344 0x439f 0x7aa9 0x9329 0x440a 0x7c57 0x9307 0x44ed 0x7e05 0x92e1 0x45e7 0x7fb4 0x92b9 0x46e3 0x8162 0x928f 0x47f2 0x8310 0x9263 0x48fb 0x84be 0x9233 0x49aa 0x866c 0x9206 0x4a9e 0x881a 0x91e4 0x4bb2 0x89c8 0x91c9 0x4cd0 0x8b77 0x9190 0x4d6f 0x8d25 0x9138 0x4d89 0x8ed3 0x90e6 0x4dfc 0x9081 0x90a5 0x5004 0x922f 0x907b 0x5189 0x93dd 0x9058 0x52f6 0x958b 0x9035 0x5443 0x973a 0x900a 0x55c6 0x98e8 0x8fca 0x578c 0x9a96 0x8f53 0x595d 0x9c44 0x8e66 0x5b65 0x9df2 0x8c9b 0x5d6e 0x9fa0 0x89f7 0x60df 0xa14f 0x85ee 0x66bd 0xa2fd 0x83bb 0x6a04 0xa4ab 0x83bb 0x6a04 0xa659 0x83bb 0x6a04>;
			battery0_profile_t3_num = <0x64>;
			compatible = "mediatek,bat_gm30";
			g_FG_PSEUDO100_T0 = <0x62>;
			g_FG_PSEUDO100_T1 = <0x62>;
			g_FG_PSEUDO100_T2 = <0x5f>;
			g_FG_PSEUDO100_T3 = <0x5a>;
			g_FG_PSEUDO100_T4 = <0x50>;
		};
	};

	fragment@32 {
		target = <0xffffffff>;

		__overlay__ {
			status = "okay";

			dbmd4_interface@0x0 {
				compatible = "dspg,dbmd4-spi";
				dma_min_buffer_size = <0x0>;
				linux,phandle = <0x4f>;
				phandle = <0x4f>;
				read-chunk-size = <0x2000>;
				reg = <0x0>;
				spi-max-frequency = <0x7735940>;
				write-chunk-size = <0x8000>;
			};
		};
	};

	fragment@33 {
		target = <0xffffffff>;

		__overlay__ {
			status = "okay";

			dbmd2_interface@0x0 {
				compatible = "dspg,dbmd2-spi";
				dma_min_buffer_size = <0x0>;
				linux,phandle = <0x4e>;
				phandle = <0x4e>;
				read-chunk-size = <0x2000>;
				reg = <0x0>;
				spi-max-frequency = <0x7735940>;
				write-chunk-size = <0x8000>;
			};
		};
	};

	fragment@34 {
		target = <0xffffffff>;

		__overlay__ {
			alsa_streaming_options = <0xc>;
			amodel_options = <0x1>;
			asrp_delay = <0x1d6>;
			asrp_gain = <0x2cfc>;
			auto_buffering = <0x1>;
			auto_detection = <0x1>;
			boot_options = <0x201>;
			boot_options_va_ve = <0x200>;
			buffering_timeout = <0x5>;
			cd-interfaces = <0x4e 0x4f>;
			change_clock_src_options = <0x4003>;
			compatible = "dspg,dbmdx-codec";
			default-streaming-usecase-name = "uc_mango_barge_in_48k_16b_no_speaker";
			default_va_clock = <0x5dc0000>;
			detection_after_buffering = <0x1>;
			detection_buffer_channels = <0x0>;
			feature-va_ve;
			firmware_id = <0xdbd4>;
			firmware_id_va_ve = <0xdbd2>;
			hw_revision = <0x3>;
			low_power_mode_disabled = <0x0>;
			master-clk-rate = <0x8000>;
			master_va_ve-clk-rate = <0x1770000>;
			multi-interface-support = <0x1>;
			pcm_streaming_mode = <0x1>;
			qed_enabled = <0x0>;
			reset-gpio = <0xffffffff 0x7c 0x0>;
			reset-va_ve-gpio = <0xffffffff 0x7d 0x0>;
			reset_gpio_shared = <0x0>;
			send_uevent_after_buffering = <0x1>;
			send_uevent_on_detection = <0x1>;
			send_wakeup_seq = <0x0>;
			send_wakeup_va_ve_seq = <0x0>;
			status = "okay";
			sv-gpio = <0xffffffff 0x8 0x0>;
			uart_low_speed_enabled = <0x1>;
			use_gpio_for_wakeup = <0x1>;
			use_gpio_for_wakeup_va_ve = <0x1>;
			va-config = <0x80000000 0x80000000 0x80000000 0x80290020 0x801b0020 0x80091000 0x80221002 0x80330011 0x80230000 0x80158f8f 0x801a0013 0x8010f000 0x8aab0040 0x801e0010 0x8aab0040 0x800c7530 0x80000000 0x80000000 0x80000000>;
			va-firmware-name = "dbmd4_va_fw.bin";
			va-interfaces = <0x1 0x1 0x1 0x1>;
			va-mic-config = <0x5076 0xa061 0x8>;
			va-mic-mode = <0x0>;
			va-preboot-firmware-name = "dbmd4_va_preboot_fw.bin";
			va-speeds = <0x0 0x70800 0x0 0xf4240 0x0 0x1e8480 0x0 0x2dc6c0 0x0 0x2dc6c0 0x0 0x4c4b40>;
			va_backlog_length = <0x2>;
			va_backlog_length_okg = <0x3e8>;
			va_ve-config = <0x80000000 0x80000000 0x80000000 0x80290030 0x801b6000 0x80090020 0x80220000 0x80230000 0x801f0300 0x8010c001 0x8aab0040 0x800c7530 0x80000000 0x80000000 0x80000000>;
			va_ve-firmware-name = "dbmd2_va_ve_fw.bin";
			va_ve-interfaces = <0x0 0x0 0x0 0x0>;
			va_ve-mic-config = <0x5096 0xa081 0xa093 0x0>;
			va_ve-preboot-firmware-name = "dbmd2_va_preboot_fw.bin";
			va_ve_separate_clocks = <0x1>;
			wakeup-gpio = <0xffffffff 0xa 0x0>;
			wakeup-va_ve-gpio = <0xffffffff 0x7 0x0>;
			wakeup_disabled = <0x0>;
			wakeup_set_value = <0x0>;
			wakeup_va_ve_disabled = <0x0>;
			wakeup_va_ve_set_value = <0x1>;
		};
	};

	fragment@35 {
		target = <0xffffffff>;

		__overlay__ {

			adc_channel@ {
				compatible = "mediatek,adc_channel";
				mediatek,temperature0 = <0x0>;
				mediatek,temperature1 = <0x1>;
				status = "okay";
			};
		};
	};

	fragment@36 {
		target = <0xffffffff>;

		__overlay__ {
			mediatek,clkbuf-config = <0x2 0x1 0x1 0x2 0x0 0x0 0x0>;
			mediatek,clkbuf-driving-current = <0xffffffff 0xffffffff 0xffffffff 0xffffffff 0xffffffff 0xffffffff 0xffffffff>;
			mediatek,clkbuf-quantity = <0x7>;
			status = "okay";
		};
	};

	fragment@37 {
		target = <0xffffffff>;

		__overlay__ {
			#address-cells = <0x1>;
			#size-cells = <0x0>;
			clock-frequency = <0x61a80>;
			mediatek,use-open-drain;

			i2c_lcd_bias@3e {
				compatible = "mediatek,i2c_lcd_bias";
				linux,phandle = <0x59>;
				phandle = <0x59>;
				reg = <0x3e>;
				status = "okay";
			};
		};
	};

	fragment@38 {
		target = <0xffffffff>;

		__overlay__ {
			#address-cells = <0x1>;
			#size-cells = <0x0>;
			clock-frequency = <0x61a80>;
			mediatek,use-open-drain;

			alsps@51 {
				compatible = "mediatek,alsps";
				linux,phandle = <0x60>;
				phandle = <0x60>;
				reg = <0x51>;
				status = "okay";
			};

			barometer@77 {
				compatible = "mediatek,barometer";
				linux,phandle = <0x5e>;
				phandle = <0x5e>;
				reg = <0x77>;
				status = "okay";
			};

			gsensor@18 {
				compatible = "mediatek,gsensor";
				linux,phandle = <0x5f>;
				phandle = <0x5f>;
				reg = <0x18>;
				status = "okay";
			};

			gyro@69 {
				compatible = "mediatek,gyro";
				linux,phandle = <0x5c>;
				phandle = <0x5c>;
				reg = <0x69>;
				status = "okay";
			};

			msensor@0c {
				compatible = "mediatek,msensor";
				linux,phandle = <0x5d>;
				phandle = <0x5d>;
				reg = <0xc>;
				status = "okay";
			};

			strobe_main@63 {
				compatible = "mediatek,strobe_main";
				linux,phandle = <0x5b>;
				phandle = <0x5b>;
				reg = <0x63>;
				status = "okay";
			};

			sw_charger@6a {
				compatible = "mediatek,sw_charger";
				linux,phandle = <0x5a>;
				phandle = <0x5a>;
				reg = <0x6a>;
				status = "okay";
			};
		};
	};

	fragment@39 {
		target = <0xffffffff>;

		__overlay__ {
			#address-cells = <0x1>;
			#size-cells = <0x0>;
			clock-frequency = <0x61a80>;
			mediatek,use-open-drain;

			camera_main@3c {
				compatible = "mediatek,camera_main";
				linux,phandle = <0x61>;
				phandle = <0x61>;
				reg = <0x3c>;
				status = "okay";
			};

			camera_main_af@72 {
				compatible = "mediatek,camera_main_af";
				linux,phandle = <0x62>;
				phandle = <0x62>;
				reg = <0x72>;
				status = "okay";
			};

			camera_main_eeprom@3d {
				compatible = "mediatek,camera_main_eeprom";
				linux,phandle = <0x64>;
				phandle = <0x64>;
				reg = <0x3d>;
				status = "okay";
			};

			camera_sub@36 {
				compatible = "mediatek,camera_sub";
				linux,phandle = <0x63>;
				phandle = <0x63>;
				reg = <0x36>;
				status = "okay";
			};

			camera_sub_eeprom@37 {
				compatible = "mediatek,camera_sub_eeprom";
				linux,phandle = <0x65>;
				phandle = <0x65>;
				reg = <0x37>;
				status = "okay";
			};
		};
	};

	fragment@4 {
		target = <0xffffffff>;

		__overlay__ {

			alspsdefaultcfg {
				linux,phandle = <0x1>;
				phandle = <0x1>;
			};

			alspspincfg {
				linux,phandle = <0x2>;
				phandle = <0x2>;

				pins_cmd_dat {
					bias-pull-up = <0x65>;
					pins = <0x100>;
					slew-rate = <0x0>;
				};
			};
		};
	};

	fragment@40 {
		target = <0xffffffff>;

		__overlay__ {
			#address-cells = <0x1>;
			#size-cells = <0x0>;
			clock-frequency = <0x61a80>;
			mediatek,use-open-drain;
		};
	};

	fragment@41 {
		target = <0xffffffff>;

		__overlay__ {
			#address-cells = <0x1>;
			#size-cells = <0x0>;
			clock-frequency = <0x61a80>;
			mediatek,use-open-drain;
		};
	};

	fragment@42 {
		target = <0xffffffff>;

		__overlay__ {
			#address-cells = <0x1>;
			#size-cells = <0x0>;
			clock-frequency = <0x61a80>;
			mediatek,use-open-drain;
		};
	};

	fragment@43 {
		target = <0xffffffff>;

		__overlay__ {
			GPIO_SIM1_HOT_PLUG = <0xffffffff 0x5b 0x0>;
			GPIO_SIM1_SCLK = <0xffffffff 0x4d 0x0>;
			GPIO_SIM1_SIO = <0xffffffff 0x4f 0x0>;
			GPIO_SIM1_SRST = <0xffffffff 0x4e 0x0>;
			GPIO_SIM2_SCLK = <0xffffffff 0x50 0x0>;
			GPIO_SIM2_SIO = <0xffffffff 0x52 0x0>;
			GPIO_SIM2_SRST = <0xffffffff 0x51 0x0>;
		};
	};

	fragment@44 {
		target = <0xffffffff>;

		__overlay__ {
			interrupt-parent = <0xffffffff>;
			interrupts = <0x1 0x2 0x1 0x0>;
			status = "okay";
		};
	};

	fragment@45 {
		target = <0xffffffff>;

		__overlay__ {
			deb-gpios = <0xffffffff 0x4 0x0>;
			debounce = <0x7d00>;
			interrupt-parent = <0xffffffff>;
			interrupts = <0x4 0x8 0x4 0x0>;
			status = "okay";
		};
	};

	fragment@46 {
		target = <0xffffffff>;

		__overlay__ {
			deb-gpios = <0xffffffff 0x5 0x0>;
			debounce = <0x7d00>;
			interrupt-parent = <0xffffffff>;
			interrupts = <0x5 0x4 0x5 0x0>;
			status = "okay";
		};
	};

	fragment@47 {
		target = <0xffffffff>;

		__overlay__ {
			interrupt-parent = <0xffffffff>;
			interrupts = <0x6 0x2 0x6 0x0>;
			status = "okay";
		};
	};

	fragment@48 {
		target = <0xffffffff>;

		__overlay__ {
			deb-gpios = <0xffffffff 0xe 0x0>;
			debounce = <0x7d00>;
			interrupt-parent = <0xffffffff>;
			interrupts = <0xe 0x4 0xe 0x0>;
			status = "okay";
		};
	};

	fragment@49 {
		target = <0xffffffff>;

		__overlay__ {
			interrupt-parent = <0xffffffff>;
			interrupts = <0xf 0x2 0xf 0x0>;
			status = "okay";
		};
	};

	fragment@5 {
		target = <0xffffffff>;

		__overlay__ {
			accdet-mic-mode = <0x1>;
			accdet-mic-vol = <0x6>;
			accdet-plugout-debounce = <0x1>;
			headset-eint-level-pol = <0x8>;
			headset-four-key-threshold = <0x0 0x3a 0x79 0xc0 0x190>;
			headset-mode-setting = <0x500 0x500 0x1 0x1f0 0x800 0x800 0x20 0x44>;
			headset-three-key-threshold = <0x0 0x50 0xdc 0x190>;
			headset-three-key-threshold-CDD = <0x0 0x79 0xc0 0x258>;
			pinctrl-0 = <0x5>;
			pinctrl-1 = <0x6>;
			pinctrl-names = "default", "state_eint_as_int";
			status = "okay";
		};
	};

	fragment@50 {
		target = <0xffffffff>;

		__overlay__ {
			interrupt-parent = <0xffffffff>;
			interrupts = <0x19 0x2 0x19 0x0>;
			status = "okay";
		};
	};

	fragment@51 {
		target = <0xffffffff>;

		__overlay__ {
			deb-gpios = <0xffffffff 0x87 0x0>;
			debounce = <0x3e8>;
			interrupt-parent = <0xffffffff>;
			interrupts = <0x87 0x8 0x87 0x0>;
			status = "okay";
		};
	};

	fragment@52 {
		target = <0xffffffff>;

		__overlay__ {
			interrupt-parent = <0xffffffff>;
			interrupts = <0xb6 0x4 0x3a 0x1>;
			status = "okay";
		};
	};

	fragment@53 {
		target = <0xffffffff>;

		__overlay__ {
			compatible = "mediatek,md1_sim1_hot_plug_eint-eint";
			debounce = <0x0 0x186a0>;
			dedicated = <0x0 0x0>;
			interrupts = <0x0 0x8>;
			sockettype = <0x0 0x0>;
			src_pin = <0x0 0x1>;
			status = "okay";
		};
	};

	fragment@54 {
		target = <0xffffffff>;

		__overlay__ {
			regulator-default-on = <0x0>;
			regulator-name = "vcama";
			status = "okay";
		};
	};

	fragment@55 {
		target = <0xffffffff>;

		__overlay__ {
			regulator-default-on = <0x1>;
			regulator-name = "vsim1";
			status = "okay";
		};
	};

	fragment@56 {
		target = <0xffffffff>;

		__overlay__ {
			regulator-default-on = <0x1>;
			regulator-name = "vsim2";
			status = "okay";
		};
	};

	fragment@57 {
		target = <0xffffffff>;

		__overlay__ {
			regulator-default-on = <0x0>;
			regulator-name = "vcamd";
			status = "okay";
		};
	};

	fragment@58 {
		target = <0xffffffff>;

		__overlay__ {
			regulator-default-on = <0x0>;
			regulator-name = "vcamio";
			status = "okay";
		};
	};

	fragment@59 {
		target = <0xffffffff>;

		__overlay__ {
			regulator-default-on = <0x1>;
			regulator-name = "vldo28";
			status = "okay";
		};
	};

	fragment@6 {
		target = <0xffffffff>;

		__overlay__ {

			accdetdefault {
				linux,phandle = <0x5>;
				phandle = <0x5>;
			};

			accdeteint@0 {
				linux,phandle = <0x6>;
				phandle = <0x6>;

				pins_cmd_dat {
					bias-disable;
					slew-rate = <0x0>;
				};
			};
		};
	};

	fragment@60 {
		target = <0xffffffff>;

		__overlay__ {
			status = "okay";
			vcama-supply = <0xffffffff>;
			vcama_sub-supply = <0xffffffff>;
			vcamaf-supply = <0xffffffff>;
			vcamd-supply = <0xffffffff>;
			vcamd_sub-supply = <0xffffffff>;
			vcamio-supply = <0xffffffff>;
			vcamio_sub-supply = <0xffffffff>;
		};
	};

	fragment@61 {
		target = <0xffffffff>;

		__overlay__ {
			status = "okay";
			vtouch-supply = <0xffffffff>;
		};
	};

	fragment@62 {
		target = <0xffffffff>;

		__overlay__ {
			mediatek,kpd-hw-dl-key0 = <0x0>;
			mediatek,kpd-hw-dl-key1 = <0x1>;
			mediatek,kpd-hw-dl-key2 = <0x8>;
			mediatek,kpd-hw-factory-key = <0x1>;
			mediatek,kpd-hw-init-map = <0x73 0x72 0x0 0x0 0x0 0x0 0x0 0x0 0x0 0x0 0x0 0x0 0x0 0x0 0x0 0x0 0x0 0x0 0x0 0x0 0x0 0x0 0x0 0x0 0x0 0x0 0x0 0x0 0x0 0x0 0x0 0x0 0x0 0x0 0x0 0x0 0x0 0x0 0x0 0x0 0x0 0x0 0x0 0x0 0x0 0x0 0x0 0x0 0x0 0x0 0x0 0x0 0x0 0x0 0x0 0x0 0x0 0x0 0x0 0x0 0x0 0x0 0x0 0x0 0x0 0x0 0x0 0x0 0x0 0x0 0x0 0x0>;
			mediatek,kpd-hw-map-num = <0x48>;
			mediatek,kpd-hw-pwrkey = <0x8>;
			mediatek,kpd-hw-recovery-key = <0x0>;
			mediatek,kpd-key-debounce = <0x400>;
			mediatek,kpd-pwkey-gpio-din = <0x0>;
			mediatek,kpd-pwrkey-eint-gpio = <0x0>;
			mediatek,kpd-sw-pwrkey = <0x74>;
			mediatek,kpd-use-extend-type = <0x0>;
			status = "okay";
		};
	};

	fragment@7 {
		target = <0xffffffff>;

		__overlay__ {

			consys_default {
				linux,phandle = <0x7>;
				phandle = <0x7>;
			};

			gpslna@0 {
				linux,phandle = <0x8>;
				phandle = <0x8>;

				pins_cmd_dat {
					bias-disable;
					output-low;
					pins = <0x300>;
					slew-rate = <0x0>;
				};
			};

			gpslna@1 {
				linux,phandle = <0x9>;
				phandle = <0x9>;

				pins_cmd_dat {
					output-high;
					pins = <0x300>;
					slew-rate = <0x1>;
				};
			};

			gpslna@2 {
				linux,phandle = <0xa>;
				phandle = <0xa>;

				pins_cmd_dat {
					output-low;
					pins = <0x300>;
					slew-rate = <0x1>;
				};
			};
		};
	};

	fragment@8 {
		target = <0xffffffff>;

		__overlay__ {
			pinctrl-0 = <0x7>;
			pinctrl-1 = <0x8>;
			pinctrl-2 = <0x9>;
			pinctrl-3 = <0xa>;
			pinctrl-names = "default", "gps_lna_state_init", "gps_lna_state_oh", "gps_lna_state_ol";
			status = "okay";
		};
	};

	fragment@9 {
		target = <0xffffffff>;

		__overlay__ {
			clock-frequency = <0x61a80>;

			cap_touch@38 {
				compatible = "mediatek,cap_touch";
				reg = <0x38>;
				status = "okay";
			};

			cap_touch@5d {
				compatible = "mediatek,cap_touch0";
				reg = <0x5d>;
				status = "okay";
			};
		};
	};
};
